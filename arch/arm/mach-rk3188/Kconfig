## arch/arm/mach-rk3188/Kconfig
```kconfig
choice
	prompt "Rockchip SoC Type"
	depends on ARCH_RK3188

config SOC_RK3188
	bool "RK3188"
	select USB_ARCH_HAS_EHCI if USB_SUPPORT

config SOC_RK3188M
	bool "RK3188M"
	select USB_ARCH_HAS_EHCI if USB_SUPPORT

endchoice

choice
	prompt "RK3188 Board Type"
	depends on SOC_RK3188

config MACH_RK3188_TB
	bool "RK3188 Top Board"

config MACH_RK3188_SDK
	bool "RK3188 sdk Board"

config MACH_RK3188_FPGA
	bool "RK3188 FPGA board"
	select RK_FPGA

config MACH_RK3188_LR097
        bool "RK3188 LR097 JC21CA board"

config MACH_RK3188_DS1006H
	bool "RK3188 ds1006h board"

config MACH_RK3188_U30GT2
	bool "RK3188 u30gt2 board"

        
config MACH_RK3188_FAC
        bool "RK3188 Board for factory"
        select MACH_RK_FAC

config MACH_RK3188_JETTAB
	bool "RK3188 jettaB top board"

config MACH_RK3188_RK618
        bool "RK3188 RK618 sdk"

config MACH_RK3188_FT
	bool "RK3188 FT Board"
	select LZO_COMPRESS
        select LZO_DECOMPRESS
config MACH_RK3188_AC
        bool "RK3188 android computer board"
config MACH_RK3188_NOTEBOOK
    bool "RK3188 notebook board"
    
#$_rbox_$_modify_$_begin		
config MACH_RK3188_BOX
	bool "RK3188 Box Board"
#$_rbox_$_modify_$_end

endchoice

choice
	prompt "RK3188M Board Type"
	depends on SOC_RK3188M

config MACH_RK3188M_TB
	bool "RK3188m Top Board"
	
config MACH_RK3188M_F304
	bool "RK3188m F304 Board"	

endchoice

#$_rbox_$_modify_$_begin
choice
	prompt "RK3188 Box Board Type"
	depends on MACH_RK3188_BOX
	default MACH_RK3188_BOX_PANCAKE

	config MACH_RK3188_BOX_PANCAKE
	bool "Pancake(SDK)"
	
	config MACH_RK3188_BOX_HOTDOG
	bool "Hotdog(Dongle)"
	
	config MACH_RK3188_BOX_COSTDOWN
	bool "Costdown"

endchoice
#$_rbox_$_modify_$_end
```

## drivers/efuse/Kconfig
```kconfig
#
# efuse configuration
#


menu "EFUSE support"
 config RK_EFUSE
	bool "EFUSE support"
	help
	  if you want use efuse function , pls enable it
endmenu
```

## drivers/hsadc/Kconfig
```kconfig
config ROCKCHIP_HSADC
	bool "Hsadc support"
	depends on ARCH_ROCKCHIP
	default n
	help
	  Say Y here to enable Rockchip hsadc driver.

	  
```

## drivers/input/remotectl/Kconfig
```kconfig
#
# Touchscreen driver configuration
#
menuconfig ROCKCHIP_REMOTECTL
	bool "rkxx remotectl"
	default n
	help
	  Say Y here, will suport rk remotectl.
	  This option doesn't affect the kernel.
	  If unsure, say Y.
	  
if ROCKCHIP_REMOTECTL  

config RK_REMOTECTL_GPIO
	bool "rkxx remoctrl gpio"
	default y
	
config RK_REMOTECTL_PWM
    bool "rkxx remoctrl pwm0 capture"
	default n
endif
```

## drivers/input/touchscreen/aw5x0x/Kconfig
```kconfig
config TOUCHSCREEN_AW5209
      tristate "aw5209 touchscreen driver"
      help
      aw5209 touchscreen driver
```

## drivers/input/touchscreen/zet62xx/Kconfig
```kconfig
#
config TOUCHSCREEN_ZET62XX
tristate "zet62xx touchscreen driver"
help
zet62xx touchscreen driver
```

## drivers/media/rkdtv/Kconfig
```kconfig
if DVB_CORE
config ROCKCHIP_DTV
	bool "Supported Rockchip Adapters"
	depends on DVB_CORE
	default y  
endif

choice
depends on ROCKCHIP_DTV
prompt "Select Adapter for RK29"
default DIBCOM1009XH_CONTROL

config AU8524_CONTROL
    bool "ATSC-T AU8524 CONTROL"

config MTV818_CONTROL
    bool "ISDB-T MTV818 CONTROL"
config DIBCOM8096_CONTROL
    tristate "ISDB-T DIBCOM8096 CONTROL"
config DIBCOM7090_CONTROL
tristate "DVB-T DIBCOM7090 CONTROL"
    
config NMI310_CONTROL
    bool "DVB-T NMI310 CONTROL"
	
config NMI320_CONTROL
    bool "DVB-T NMI320 CONTROL"
	
config SIANO1130_CONTROL
    bool "ISDB-T SIANO1130 CONTROL"
    
config GX1131_CONTROL
    bool "DVB-S/DVB-S2 GX1131 CONTROL"    
    
config GX1001_CONTROL
    bool "DVB-C GX1001 CONTROL"       
    
config ITE9133_CONTROL
    bool "DVB-T ITE9133 CONTROL"    
    
config DIBCOM1009XH_CONTROL
	bool "Dibcom1009XH CONTROL"
endchoice
choice
	prompt "Dib10096XH Mode select"
	depends on DIBCOM1009XH_CONTROL
	default DIBCOM1009XH_DVB_CONTROL
	---help---
		
config DIBCOM1009XH_DVB_CONTROL   
	  bool "DVBT Mode"  	
	  
config DIBCOM1009XH_ISDB_ONESEG_CONTROL   
	  bool "ISDBT One Seg Mode" 
	  
config DIBCOM1009XH_ISDB_FULLSEG_CONTROL   
	  bool "ISDBT Full Seg Mode" 
	  
if DIBCOM1009XH_ISDB_FULLSEG_CONTROL && DVB_CORE
config DIBCOM1009XH_ISDB_BCAS
	bool "Supported ISDB BCAS Syetem Support"
	depends on DIBCOM1009XH_ISDB_FULLSEG_CONTROL
	default n  
endif 	  
endchoice   


      
```

## drivers/misc/mediatek/Kconfig
```kconfig
menuconfig MTK_WIRELESS_SOLUTION	
	bool "MTK wireless chip configuration"
	help
	  "enable/disable and config MTK wireless solution"

if MTK_WIRELESS_SOLUTION
source "drivers/misc/mediatek/combo_mt66xx/Kconfig"
source "drivers/misc/mediatek/mt6622/Kconfig"
endif
```

## drivers/misc/mediatek/combo_mt66xx/Kconfig
```kconfig
menuconfig MTK_COMBO_MT66XX
	bool "MediaTek combo_mt66xx Config"
	help
	  Config MTK combo chip mt6628&mt6620

if MTK_COMBO_MT66XX

config MTK_COMBO_WMT
	tristate "MediaTek Combo Chip wireless managment tool"
	default y
	help
	  MTK wireless managment tool for WIFI/BT/GPS/FM

config MTK_COMBO_BT
	tristate "MediaTek Combo Chip BT driver"
	default y
	#depends on MTK_COMBO_WMT
	help
	  MTK BT /dev/stpbt driver for Bluedroid (mtk_stp_bt.ko)

config MTK_COMBO_FM
	tristate "MediaTek Combo Chip FM driver"
	default y
	#depends on MTK_COMBO_WMT
	help
	  MTK FM /dev/fm driver 

config MTK_COMBO_GPS
	tristate "MediaTek GPS Support"
	default y
	#depends on MTK_COMBO_WMT
	help
	  MTK GPS /dev/gps driver (mtk_gps.ko)

endif
```

## drivers/misc/mediatek/mt6622/Kconfig
```kconfig
menuconfig MTK_MT6622
	bool "MediaTek Discrete BT Chip MT6622"
	help
	  MTK Discrete BT chip MT6622

config MTK_MT6622_HW_CTL
	bool "MediaTek BT Hardware Control driver"
	depends on MTK_MT6622
	default y
	help
	  MTK BT hardware control driver for discrete BT chip
```

## drivers/misc/rk_ipc/Kconfig
```kconfig
#
# all auto modem control drivers configuration
#

config RK_IPC
	bool "RK3190 IPC"
	default n	
```

## drivers/net/wireless/rkusbwifi/rtl8723bu/Kconfig
```kconfig
config RTL8723BU
	tristate "Realtek 8723BU USB WiFi Support"
	depends on USB
    select WIRELESS_EXT
    select WEXT_PRIV
    select IEEE80211
	---help---
	  Help message of RTL8723BU
```

## drivers/video/rockchip/Kconfig
```kconfig
menuconfig FB_ROCKCHIP
        tristate "Frame buffer support for Rockchip "
        depends on FB
        select FB_CFB_FILLRECT
        select FB_CFB_COPYAREA
        select FB_CFB_IMAGEBLIT
        ---help---
          Framebuffer driver for rockchip based platform

config THREE_FB_BUFFER
        bool "Three fb buffer support"
        depends on FB_ROCKCHIP
        default y
        help
           select y if android support three buffer,like Jelly Bean

config DISPLAY_KEY_LED_CONTROL
	bool "Enable LED control for display interface."
	depends on FB_ROCKCHIP
	default n
	help
	   slect y if you need use led to indicate display status.

source "drivers/video/rockchip/lcdc/Kconfig"
source "drivers/video/rockchip/screen/Kconfig"
source "drivers/video/rockchip/hdmi/Kconfig"
source "drivers/video/rockchip/tvencoder/Kconfig"
source "drivers/video/rockchip/transmitter/Kconfig"
source "drivers/video/rockchip/rga/Kconfig"
source "drivers/video/rockchip/iep/Kconfig"
source "drivers/video/rockchip/rga2/Kconfig"
```

## drivers/video/rockchip/hdmi/rk3028a/Kconfig
```kconfig
config  HDMI_RK3028A
        bool "RK3028A HDMI support"
        depends on LCDC_RK3188 && RK_HDMI
        help
           Support rk3028a hdmi if you say y here

config HDCP_RK3028A
	bool "RK3028A HDCP support"
        depends on HDMI_RK3028A
        default n
	help
	  HDCP Interface. This adds the High Definition Content Protection Interface.
	  See http://www.digital-cp.com/ for HDCP specification.
	  
config CEC_RK3028A
	bool "RK3028A CEC support(EXPERIMENTAL)"
	 depends on HDMI_RK3028A
        default n
	help
	  CEC Interface. Under developing, not stable.
```

## drivers/video/rockchip/hdmi/rk3288/Kconfig
```kconfig
config  HDMI_RK3288
        bool "RK32 HDMI support"
        depends on LCDC_RK3288 && RK_HDMI
        help
           Support rk32 hdmi if you say y here
```

## drivers/video/rockchip/hdmi/rk616/Kconfig
```kconfig
config  HDMI_RK616
        bool "RK616 HDMI support"
        depends on LCDC_RK3188 && RK_HDMI
        help
           Support rk3028a hdmi if you say y here
```

## drivers/video/rockchip/iep/Kconfig
```kconfig
menu "IEP"
	depends on ARCH_RK3026 || ARCH_RK319X

config IEP
	tristate "ROCKCHIP IEP driver"
        default y
	help
	  rockchip iep module.

config IEP_MMU
        tristate "ROCKCHIP IEP MMU driver"
        depends on ARCH_RK319X
        default y
        help
          rockchip iep mmu

endmenu
```

## drivers/video/rockchip/rga2/Kconfig
```kconfig
menu "RGA2"
	depends on ARCH_RK32 || ARCH_RK319X

config RGA2_RK32
	tristate "ROCKCHIP RK32 || RK319X RGA2"
	help
	  rk32 rga2 module.

endmenu
```

## drivers/video/rockchip/vga/Kconfig
```kconfig
#
# VGA drivers configuration
#

config RK_VGA
	bool "VGA support"
	help
		Support ADV7123 VGA output if you say y here.
```
